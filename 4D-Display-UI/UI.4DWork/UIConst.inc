// File generated 2/14/2023 7:47:56 PM
// Warning! This is a generated file, any manual changes will be
// lost during the next generation.

#constant  Strings0Count    0
#constant  Strings0Size     1
#constant  Strings7Count    0
#constant  Strings7Size     1
#constant  Strings1Count    0
#constant  Strings1Size     1
#constant  Strings5Count    0
#constant  Strings5Size     1
#constant  Strings6Count    0
#constant  Strings6Size     1
#constant  Strings2Count    0
#constant  Strings2Size     1
#constant  Strings3Count    0
#constant  Strings3Size     1
#constant  Strings4Count    0
#constant  Strings4Size     1
#constant  IFONT_OFFSET     0
// object indexes into ImageControl
#CONST
    iStatictext0    // offset 0x0
    i4Dbutton0      // offset 0x2C00
    iStatictext1    // offset 0x7600
    iUserled0       // offset 0x8200
    iWinbutton0     // offset 0x9000
    iStatictext2    // offset 0xD200
    iLed0           // offset 0xD600
    iStatictext8    // offset 0xFE00
    iWinbutton1     // offset 0x10800
    iWinbutton2     // offset 0x14A00
    iWinbutton3     // offset 0x18C00
    iWinbutton4     // offset 0x1CE00
    iWinbutton5     // offset 0x21000
    iWinbutton6     // offset 0x25200
    iStatictext5    // offset 0x29400
    iStatictext6    // offset 0x29A00
    iStatictext7    // offset 0x29E00
    iWinbutton7     // offset 0x2A400
    iWinbutton9     // offset 0x2E600
    iWinbutton10    // offset 0x31600
    iWinbutton8     // offset 0x34800
    iStatictext3    // offset 0x38600
    iStatictext4    // offset 0x3B800
#END


#constant  Strings0StartH   0x0
#constant  Strings0StartL   0x0
#constant  Strings7StartH   0x0
#constant  Strings7StartL   0x200
#constant  Strings1StartH   0x0
#constant  Strings1StartL   0x400
#constant  Strings5StartH   0x0
#constant  Strings5StartL   0x600
#constant  Strings6StartH   0x0
#constant  Strings6StartL   0x800
#constant  Strings2StartH   0x0
#constant  Strings2StartL   0xA00
#constant  Strings3StartH   0x0
#constant  Strings3StartL   0xC00
#constant  Strings4StartH   0x0
#constant  Strings4StartL   0xE00

#IFNOT EXISTS NOGLOBALS
var hndl ;
var hFonts[8] ;
#ENDIF
